## config/boards/shields/tightyl/Kconfig.defconfig
```kconfig
if SHIELD_TIGHTYL_LEFT

config ZMK_KEYBOARD_NAME
        default "Tightyl Left"

config ZMK_SPLIT_BLE_ROLE_CENTRAL
        default y

endif


if SHIELD_TIGHTYL_RIGHT

config ZMK_KEYBOARD_NAME
        default "Tightyl Right"

endif


if SHIELD_TIGHTYL_LEFT || SHIELD_TIGHTYL_RIGHT

config ZMK_SPLIT
    default y

endif


if ZMK_BACKLIGHT

config PWM
    default y

config LED_PWM
    default y

endif # ZMK_BACKLIGHT
```
